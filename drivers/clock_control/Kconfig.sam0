## drivers/clock_control/Kconfig.sam0
```kconfig
# Kconfig - Clock controller driver configuration options
#
# Copyright (c) 2019 Derek Hageman <hageman@inthat.cloud>
#
# SPDX-License-Identifier: Apache-2.0

if SOC_SERIES_SAMD20 || SOC_SERIES_SAMD21

config CLOCK_CONTROL_SAMD2X
	bool
	default y

endif # SOC_SERIES_SAMD20 || SOC_SERIES_SAMD21
```

## drivers/i2c/Kconfig.sam0
```kconfig
#
# Copyright (c) 2019 Derek Hageman <hageman@inthat.cloud>
#
# SPDX-License-Identifier: Apache-2.0
#

menuconfig I2C_SAM0
	bool "SAM0 series I2C SERCOM driver"
	default y
	depends on SOC_FAMILY_SAM0
	select HAS_DTS_I2C
	help
	  Enable the SAM0 series SERCOM I2C driver.

config I2C_SAM0_DMA_DRIVEN
	bool "Use DMA to SAM0 I2C peripheral"
	depends on I2C_SAM0
	select DMA
	help
	  This enables DMA driven transactions for the I2C peripheral.
	  DMA driven mode requires fewer interrupts to handle the
	  transaction and ensures that high speed modes are not delayed
	  by data reloading.
```

## dts/bindings/clock/atmel,sam0-clk-src.yaml
```yaml
#
# Copyright (c) 2019 Derek Hageman <hageman@inthat.cloud>
#
# SPDX-License-Identifier: Apache-2.0
#
---
title: SAM0 Generic Clock Input Source
version: 0.1

description: >
    This is a representation an oscillator that can be used as a SAM0
    clock input source

inherits:
    !include fixed-clock.yaml

properties:
    compatible:
      type: string
      category: required
      description: compatible strings
      constraint: "atmel,sam0-clk-src"

    gclk-src-id:
      type: int
      category: optional
      description: generic clock generator source identifier
      generation: define, consumer

    fdpll-src-id:
      type: int
      category: optional
      description: generic clock generator source identifier
      generation: define, consumer
...
```

## dts/bindings/clock/atmel,sam0-clock.yaml
```yaml
#
# Copyright (c) 2019 Derek Hageman <hageman@inthat.cloud>
#
# SPDX-License-Identifier: Apache-2.0
#
---
title: Atmel SAM0 clock source
version: 0.1

description: >
    This is a representation of a clock source for Atmel SAM0 devices

properties:
    compatible:
      type: string
      category: required
      description: compatible strings
      constraint: "atmel,sam0-clock"

    label:
      type: string
      category: required
      description: Human readable string describing the device (used by Zephyr for API name)
      generation: define

    clocks:
      type: array
      category: optional
      description: input clock source
      generation: define

    clock-frequency:
      type: int
      description: output clock frequency (Hz)
      generation: define
      category: required
...
```

## dts/bindings/clock/atmel,sam0-dfll.yaml
```yaml
#
# Copyright (c) 2019 Derek Hageman <hageman@inthat.cloud>
#
# SPDX-License-Identifier: Apache-2.0
#
---
title: SAM0 Digital Frequency Locked Loop
version: 0.1

description: >
    This is a representation of the SAM0 frequency locked loop

inherits:
    !include atmel,sam0-clk-src.yaml

properties:
    compatible:
      type: string
      category: required
      description: compatible strings
      constraint: "atmel,sam0-dfll"

    clocks:
      type: array
      category: required
      description: input clock source
      generation: define
...
```

## dts/bindings/clock/atmel,sam0-fdpll.yaml
```yaml
#
# Copyright (c) 2019 Derek Hageman <hageman@inthat.cloud>
#
# SPDX-License-Identifier: Apache-2.0
#
---
title: SAM0 Fractional Digital Phase Locked Loop
version: 0.1

description: >
    This is a representation of the SAM0 phase locked loop

inherits:
    !include atmel,sam0-clk-src.yaml

properties:
    compatible:
      type: string
      category: required
      description: compatible strings
      constraint: "atmel,sam0-fdpll"

    clocks:
      type: array
      category: required
      description: input clock source
      generation: define
...
```

## dts/bindings/clock/atmel,sam0-gclk.yaml
```yaml
#
# Copyright (c) 2019 Derek Hageman <hageman@inthat.cloud>
#
# SPDX-License-Identifier: Apache-2.0
#
---
title: SAM0 Generic Clock Generator
version: 0.1

description: >
    This is a representation of a SAM0 generic clock generator

inherits:
    !include fixed-clock.yaml

properties:
    compatible:
      type: string
      category: required
      description: compatible strings
      constraint: "atmel,sam0-gclk"

    reg:
      type: int
      category: required
      description: generator index
      generation: define, consumer

    clocks:
      type: array
      category: required
      description: input clock source
      generation: define
...
```

## dts/bindings/clock/fixed-clock.yaml
```yaml
#
# Copyright (c) 2019 Derek Hageman <hageman@inthat.cloud>
#
# SPDX-License-Identifier: Apache-2.0
#
---
title: Generic fixed frequency clock
version: 0.1

description: >
    This is a representation of a generic clock at a fixed frequency

properties:
    compatible:
      type: string
      category: required
      description: compatible strings
      constraint: "fixed-clock"

    clock-frequency:
      type: int
      description: output clock frequency (Hz)
      generation: define, consumer
      category: required
...
```
